## device/erd/erd9945/Kconfig.ext_modules
```kconfig
source "$(KCONFIG_EXT_PREFIX)../common/drivers/input/touchscreen/sec_ts/Kconfig"
source "$(KCONFIG_EXT_MODULES_PREFIX)sgpu/Kconfig"
```

## device/erd/erd9955/Kconfig.ext_modules
```kconfig
source "$(KCONFIG_EXT_PREFIX)../common/drivers/input/touchscreen/sec_ts/Kconfig"
source "$(KCONFIG_EXT_MODULES_PREFIX)sgpu/Kconfig"
source "$(KCONFIG_EXT_MODULES_PREFIX)camera/camera/Kconfig"
source "$(KCONFIG_EXT_MODULES_PREFIX)sec_input/sec_input/Kconfig"
source "$(KCONFIG_EXT_MODULES_PREFIX)sec_input/touchscreen/synaptics/Kconfig"
```

## device/mx/mx8855/Kconfig.ext
```kconfig
source "$(KCONFIG_EXT_SOC_PREFIX)Kconfig.ext"

source "$(KCONFIG_EXT_PREFIX)Kconfig.ext_modules"

source "$(KCONFIG_EXT_PREFIX)drivers/samsung/Kconfig"
source "$(KCONFIG_EXT_PREFIX)sound/soc/codecs/Kconfig"
source "$(KCONFIG_EXT_PREFIX)sound/soc/codecs/tas25xx/Kconfig"
source "$(KCONFIG_EXT_PREFIX)sound/soc/samsung/exynos/Kconfig"
source "$(KCONFIG_EXT_PREFIX)sound/soc/samsung/exynos/abox/Kconfig"
source "$(KCONFIG_EXT_PREFIX)drivers/tee/tzdev/Kconfig"
source "$(KCONFIG_EXT_PREFIX)drivers/tee/tui/Kconfig"
source "$(KCONFIG_EXT_PREFIX)drivers/ufs/Kconfig"
source "$(KCONFIG_EXT_PREFIX)drivers/mmc/Kconfig"
source "$(KCONFIG_EXT_PREFIX)drivers/usb/gadget/function/Kconfig"
source "$(KCONFIG_EXT_PREFIX)drivers/camera/Kconfig"
source "$(KCONFIG_EXT_PREFIX)drivers/leds/Kconfig"
source "$(KCONFIG_EXT_PREFIX)block/Kconfig"
source "$(KCONFIG_EXT_PREFIX)drivers/usb/dwc3/Kconfig"
source "$(KCONFIG_EXT_PREFIX)drivers/usb/misc/Kconfig"
source "$(KCONFIG_EXT_PREFIX)drivers/sec_panel_notifier_v2/Kconfig" # ADDED BY LEGO AUTOMATICALLY: DO NOT SUBMIT
source "$(KCONFIG_EXT_PREFIX)drivers/usb/typec/slsi/s2mf301/Kconfig" # ADDED BY LEGO AUTOMATICALLY: DO NOT SUBMIT
source "$(KCONFIG_EXT_PREFIX)drivers/usb/typec/slsi/common/Kconfig" # ADDED BY LEGO AUTOMATICALLY: DO NOT SUBMIT
source "$(KCONFIG_EXT_PREFIX)drivers/input/sec_input/Kconfig" # ADDED BY LEGO AUTOMATICALLY: DO NOT SUBMIT
source "$(KCONFIG_EXT_PREFIX)drivers/vibrator/common/vib_info/Kconfig" # ADDED BY LEGO AUTOMATICALLY: DO NOT SUBMIT
source "$(KCONFIG_EXT_PREFIX)drivers/gpu/drm/samsung/panel/s6e3fc5/Kconfig" # ADDED BY LEGO AUTOMATICALLY: DO NOT SUBMIT
source "$(KCONFIG_EXT_PREFIX)drivers/gpu/drm/samsung/panel/s6e3fc5/kunit_test/Kconfig" # ADDED BY LEGO AUTOMATICALLY: DO NOT SUBMIT
source "$(KCONFIG_EXT_PREFIX)drivers/gpu/drm/samsung/panel/oled_common/Kconfig" # ADDED BY LEGO AUTOMATICALLY: DO NOT SUBMIT
source "$(KCONFIG_EXT_PREFIX)drivers/sensorhub/Kconfig" # ADDED BY LEGO AUTOMATICALLY: DO NOT SUBMIT
source "$(KCONFIG_EXT_PREFIX)drivers/sensorhub/debug/Kconfig" # ADDED BY LEGO AUTOMATICALLY: DO NOT SUBMIT
source "$(KCONFIG_EXT_PREFIX)drivers/sensorhub/sensor/Kconfig" # ADDED BY LEGO AUTOMATICALLY: DO NOT SUBMIT
source "$(KCONFIG_EXT_PREFIX)drivers/sensorhub/sensorhub/Kconfig" # ADDED BY LEGO AUTOMATICALLY: DO NOT SUBMIT
source "$(KCONFIG_EXT_PREFIX)drivers/sensorhub/vendor/Kconfig" # ADDED BY LEGO AUTOMATICALLY: DO NOT SUBMIT
source "$(KCONFIG_EXT_PREFIX)drivers/regulator/dio8018/Kconfig" # ADDED BY LEGO AUTOMATICALLY: DO NOT SUBMIT
source "$(KCONFIG_EXT_PREFIX)drivers/sdp/Kconfig" # ADDED BY LEGO AUTOMATICALLY: DO NOT SUBMIT
source "$(KCONFIG_EXT_PREFIX)drivers/misc/drb/Kconfig" # ADDED BY LEGO AUTOMATICALLY: DO NOT SUBMIT
source "$(KCONFIG_EXT_PREFIX)drivers/muic/common/Kconfig" # ADDED BY LEGO AUTOMATICALLY: DO NOT SUBMIT
source "$(KCONFIG_EXT_PREFIX)drivers/samsung/factory/Kconfig" # ADDED BY LEGO AUTOMATICALLY: DO NOT SUBMIT
source "$(KCONFIG_EXT_PREFIX)drivers/knox/ngksm/Kconfig" # ADDED BY LEGO AUTOMATICALLY: DO NOT SUBMIT
source "$(KCONFIG_EXT_PREFIX)drivers/sti/common/Kconfig" # ADDED BY LEGO AUTOMATICALLY: DO NOT SUBMIT
source "$(KCONFIG_EXT_PREFIX)drivers/gpu/drm/samsung/panel/ana6710/Kconfig" # ADDED BY LEGO AUTOMATICALLY: DO NOT SUBMIT
source "$(KCONFIG_EXT_PREFIX)drivers/gpu/drm/samsung/panel/ana6710/kunit_test/Kconfig" # ADDED BY LEGO AUTOMATICALLY: DO NOT SUBMIT
source "$(KCONFIG_EXT_PREFIX)drivers/usb/notify/Kconfig" # ADDED BY LEGO AUTOMATICALLY: DO NOT SUBMIT
source "$(KCONFIG_EXT_PREFIX)drivers/dpu/panel/Kconfig" # ADDED BY LEGO AUTOMATICALLY: DO NOT SUBMIT
source "$(KCONFIG_EXT_PREFIX)drivers/battery/core/Kconfig" # ADDED BY LEGO AUTOMATICALLY: DO NOT SUBMIT
source "$(KCONFIG_EXT_PREFIX)drivers/staging/android/switch/Kconfig" # ADDED BY LEGO AUTOMATICALLY: DO NOT SUBMIT
source "$(KCONFIG_EXT_PREFIX)drivers/knox/hdm/Kconfig" # ADDED BY LEGO AUTOMATICALLY: DO NOT SUBMIT
source "$(KCONFIG_EXT_PREFIX)drivers/vibrator/common/inputff/Kconfig" # ADDED BY LEGO AUTOMATICALLY: DO NOT SUBMIT
source "$(KCONFIG_EXT_PREFIX)drivers/phy/common/Kconfig" # ADDED BY LEGO AUTOMATICALLY: DO NOT SUBMIT
source "$(KCONFIG_EXT_PREFIX)drivers/usb/common/vbus_notifier/Kconfig" # ADDED BY LEGO AUTOMATICALLY: DO NOT SUBMIT
source "$(KCONFIG_EXT_PREFIX)drivers/usb/typec/manager/Kconfig" # ADDED BY LEGO AUTOMATICALLY: DO NOT SUBMIT
source "$(KCONFIG_EXT_PREFIX)drivers/sensors_lego/Kconfig" # ADDED BY LEGO AUTOMATICALLY: DO NOT SUBMIT
source "$(KCONFIG_EXT_PREFIX)drivers/fingerprint/Kconfig" # ADDED BY LEGO AUTOMATICALLY: DO NOT SUBMIT
source "$(KCONFIG_EXT_PREFIX)drivers/knox/kzt/Kconfig" # ADDED BY LEGO AUTOMATICALLY: DO NOT SUBMIT
source "$(KCONFIG_EXT_PREFIX)drivers/muic/slsi/platform/Kconfig" # ADDED BY LEGO AUTOMATICALLY: DO NOT SUBMIT
source "$(KCONFIG_EXT_PREFIX)drivers/input/input_boost/Kconfig" # ADDED BY LEGO AUTOMATICALLY: DO NOT SUBMIT
source "$(KCONFIG_EXT_PREFIX)drivers/lego/Kconfig" # ADDED BY LEGO AUTOMATICALLY: DO NOT SUBMIT
source "$(KCONFIG_EXT_PREFIX)drivers/gpu/drm/Kconfig" # ADDED BY LEGO AUTOMATICALLY: DO NOT SUBMIT
source "$(KCONFIG_EXT_PREFIX)drivers/gpu/drm/samsung/panel/Kconfig" # ADDED BY LEGO AUTOMATICALLY: DO NOT SUBMIT
source "$(KCONFIG_EXT_PREFIX)drivers/usb/typec/common/Kconfig" # ADDED BY LEGO AUTOMATICALLY: DO NOT SUBMIT
source "$(KCONFIG_EXT_PREFIX)drivers/sti/abc/Kconfig" # ADDED BY LEGO AUTOMATICALLY: DO NOT SUBMIT
source "$(KCONFIG_EXT_PREFIX)drivers/battery/battery_auth/ds28e30/Kconfig" # ADDED BY LEGO AUTOMATICALLY: DO NOT SUBMIT
source "$(KCONFIG_EXT_PREFIX)drivers/mfd/slsi/s2mf301/Kconfig" # ADDED BY LEGO AUTOMATICALLY: DO NOT SUBMIT
source "$(KCONFIG_EXT_PREFIX)drivers/vibrator/awinic/aw8624x_v9/Kconfig" # ADDED BY LEGO AUTOMATICALLY: DO NOT SUBMIT
source "$(KCONFIG_EXT_PREFIX)drivers/phy/nxp/ptn3222/Kconfig" # ADDED BY LEGO AUTOMATICALLY: DO NOT SUBMIT
source "$(KCONFIG_EXT_PREFIX)drivers/battery/battery_auth/sle956681/Kconfig" # ADDED BY LEGO AUTOMATICALLY: DO NOT SUBMIT
source "$(KCONFIG_EXT_PREFIX)drivers/regulator/et5917/Kconfig" # ADDED BY LEGO AUTOMATICALLY: DO NOT SUBMIT
source "$(KCONFIG_EXT_PREFIX)drivers/battery/charger/nu2111a_charger/Kconfig" # ADDED BY LEGO AUTOMATICALLY: DO NOT SUBMIT
source "$(KCONFIG_EXT_PREFIX)drivers/muic/slsi/s2mf301/Kconfig" # ADDED BY LEGO AUTOMATICALLY: DO NOT SUBMIT
source "$(KCONFIG_EXT_PREFIX)drivers/battery/fuelgauge/s2mf301_fuelgauge/Kconfig" # ADDED BY LEGO AUTOMATICALLY: DO NOT SUBMIT
source "$(KCONFIG_EXT_PREFIX)drivers/samsung/pm/sec_thermistor/Kconfig" # ADDED BY LEGO AUTOMATICALLY: DO NOT SUBMIT
source "$(KCONFIG_EXT_PREFIX)drivers/nfc/snvm/Kconfig" # ADDED BY LEGO AUTOMATICALLY: DO NOT SUBMIT
source "$(KCONFIG_EXT_PREFIX)drivers/input/touchscreen/goodix/berlin/Kconfig" # ADDED BY LEGO AUTOMATICALLY: DO NOT SUBMIT
source "$(KCONFIG_EXT_PREFIX)drivers/nfc/lsi/Kconfig" # ADDED BY LEGO AUTOMATICALLY: DO NOT SUBMIT
source "$(KCONFIG_EXT_PREFIX)drivers/battery/charger/s2mf301_charger/Kconfig" # ADDED BY LEGO AUTOMATICALLY: DO NOT SUBMIT
source "$(KCONFIG_EXT_PREFIX)drivers/battery/common/Kconfig" # ADDED BY LEGO AUTOMATICALLY: DO NOT SUBMIT
```

## device/mx/mx8855/drivers/gpu/drm/samsung/panel/ana6710/kunit_test/Kconfig
```kconfig
config ANA6710_A56X_TEST
	bool "KUnit test for tft_common ddi driver"
	depends on SEC_KUNIT
	help
	  TODO: Describe config fully.
```

## device/mx/mx8855/drivers/regulator/et5917/Kconfig
```kconfig
config REGULATOR_ET5917
	tristate "ETEK ET5917 voltage regulator"
	default y
	help
	  This driver supports a ETEK ET5917 voltage output regulator
	  via I2C bus. ET5917 is comprised of various LDOs.
```
